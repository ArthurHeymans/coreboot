/*
 * Simple U-Boot uImage source file containing a single kernel and FDT blob
 */

/dts-v1/;

/ {
	description = "Payload handoff";

	#address-cells = <2>;
	#size-cells = <2>;

	memory@0 {
		device_type = "memory";
	};
};
