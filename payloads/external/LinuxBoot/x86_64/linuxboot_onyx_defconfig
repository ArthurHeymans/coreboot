## payloads/external/LinuxBoot/x86_64/linuxboot_onyx_defconfig
```kconfig
CONFIG_AMD_IOMMU=y
CONFIG_AMD_IOMMU_V2=y
CONFIG_ATA=y
CONFIG_BLK_DEV_INITRD=y
CONFIG_BLK_DEV_LOOP=y
CONFIG_BLK_DEV_NVME=y
CONFIG_BLK_DEV_SD=y
CONFIG_CC_OPTIMIZE_FOR_SIZE=y
CONFIG_CMDLINE_BOOL=y
CONFIG_CPU_FREQ_DEFAULT_GOV_PERFORMANCE=y
CONFIG_CRYPTO_AES=y
CONFIG_CRYPTO_HMAC=y
CONFIG_CRYPTO_NULL=y
CONFIG_CRYPTO_SHA256=y
CONFIG_DEFAULT_HOSTNAME="linuxboot"
CONFIG_DEVTMPFS_MOUNT=y
CONFIG_DEVTMPFS=y
CONFIG_DMI_SYSFS=y
CONFIG_EMBEDDED=y
CONFIG_EXT3_FS_POSIX_ACL=y
CONFIG_EXT3_FS=y
CONFIG_EXT4_FS=y
CONFIG_GOOGLE_COREBOOT_TABLE=y
CONFIG_GOOGLE_FIRMWARE=y
CONFIG_GOOGLE_MEMCONSOLE_COREBOOT=y
CONFIG_GOOGLE_VPD=y
CONFIG_INET=y
CONFIG_INITRAMFS_SOURCE="PLACEHOLDER"
CONFIG_IPMI_DEVICE_INTERFACE=y
CONFIG_IPMI_HANDLER=y
CONFIG_IPMI_SI=y
CONFIG_IRQ_REMAP=y
CONFIG_KERNEL_XZ=y
CONFIG_KEXEC_FILE=y
CONFIG_KEXEC=y
CONFIG_LSM="n"
CONFIG_MEMTEST=y
CONFIG_MSDOS_FS=y
CONFIG_NETDEVICES=y
CONFIG_NET=y
CONFIG_NFP=y
CONFIG_NLS_CODEPAGE_437=y
CONFIG_NLS_ISO8859_1=y
CONFIG_NLS_UTF8=y
CONFIG_NVRAM=y
CONFIG_PACKET=y
CONFIG_PCI_MSI=y
CONFIG_PCI=y
CONFIG_RANDOM_TRUST_CPU=y
CONFIG_SATA_AHCI_PLATFORM=y
CONFIG_SATA_AHCI=y
CONFIG_SERIAL_8250_CONSOLE=y
CONFIG_SERIAL_8250_DW=y
CONFIG_SERIAL_8250_EXTENDED=y
CONFIG_SERIAL_8250_MANY_PORTS=y
CONFIG_SERIAL_8250_NR_UARTS=32
CONFIG_SERIAL_8250_RUNTIME_UARTS=32
CONFIG_SERIAL_8250=y
CONFIG_SERIAL_DEV_BUS=y
CONFIG_SMP=y
CONFIG_TCG_CRB=y
CONFIG_TCG_INFINEON=y
CONFIG_TCG_TIS=y
CONFIG_TCG_TPM=y
CONFIG_TIGON3=y
CONFIG_TMPFS=y
CONFIG_UNWINDER_GUESS=y
CONFIG_USB=y
CONFIG_USB_XHCI_HCD=y
CONFIG_USB_EHCI_HCD=y
CONFIG_USB_STORAGE=y
CONFIG_VFAT_FS=y
CONFIG_VIRTIO_BLK=y
CONFIG_VIRTIO_NET=y
CONFIG_VIRTIO_PCI=y
CONFIG_X86_REROUTE_FOR_BROKEN_BOOT_IRQS=y
CONFIG_XZ_DEC=y
CONFIG_X86_AMD_PLATFORM_DEVICE=y
CONFIG_X86_CPUID=y
CONFIG_X86_MSR=y
CONFIG_X86_X2APIC=y
```

## src/drivers/amd/atombios/Kconfig
```kconfig
## SPDX-License-Identifier: GPL-2.0-only

config DRIVERS_AMD_ATOMBIOS
	bool "AMD AtomBIOS modesetting driver"
	default n
	depends on PCI
	select MAINBOARD_HAS_NATIVE_VGA_INIT
	select HAVE_LINEAR_FRAMEBUFFER if MAINBOARD_DO_NATIVE_VGA_INIT
	help
	  Native display initialization for pre-Vega AMD GPUs using the AtomBIOS
	  interpreter. Executes ATOM command tables from the VBIOS to
	  program the display engine, without needing to run the 16-bit
	  option ROM or an x86 emulator.

	  The VBIOS must be available either in CBFS (as pciVVVV,DDDD.rom)
	  or in the GPU's PCI expansion ROM BAR.

	  The ATOM bytecode interpreter is architecture-independent and
	  works on both x86 and non-x86 (e.g., ARM) platforms with PCIe
	  AMD GPUs.

config DRIVERS_AMD_ATOMBIOS_V2
	bool "AMD AtomFirmware v2 initialization"
	default y
	depends on DRIVERS_AMD_ATOMBIOS
	help
	  Parse AtomFirmware v2 display topology and clock tables, initialize
	  the ASIC through its command table, and log display diagnostics.
	  This does not yet provide native DCE12 or DCN scanout.
```

## src/mainboard/amd/onyx/Kconfig
```kconfig
# SPDX-License-Identifier: GPL-2.0-only

if BOARD_AMD_ONYX

config BOARD_SPECIFIC_OPTIONS
	def_bool y
	select BOARD_ROMSIZE_KB_32768
	select SOC_AMD_GENOA
	select AMD_SOC_CONSOLE_UART
	select HAVE_ACPI_TABLES

config FMDFILE
	default "src/mainboard/amd/onyx/board.fmd"

config MAINBOARD_DIR
	default "amd/onyx"

config MAINBOARD_PART_NUMBER
	default "ONYX"

choice
	prompt "Serial interface"
	default USE_BMC_SOL
	help
	  Onyx has provision for get the serial console logs via BMC
	  or on board usb-serial connector. BMC streams the UART console
	  logs via UART1 and UART0 is routed to on board connector.
config USE_BMC_SOL
	bool "Use BMC SOL"

config USE_ONBORAD_UART
	bool "Use On Board serial"
endchoice

config UART_FOR_CONSOLE
	int
	default 0 if USE_ONBORAD_UART
	default 1 if USE_BMC_SOL

choice
	prompt "Backplanes"
	default AMD_ONYX_BACKPLANES_ALL_PCIE
	help
	  The Onyx board has multiple backplanes option. Select the one matching your board.

config AMD_ONYX_BACKPLANES_ALL_PCIE
	bool "PCIe backplanes on P and G links"

config AMD_ONYX_BACKPLANES_PLINK_SATA
	bool "SATA lanes on P links"

config AMD_ONYX_BACKPLANES_GLINK_SATA
	bool "SATA lanes on G links"

config AMD_ONYX_BACKPLANES_ALL_SATA
	bool "SATA lanes on G and P links"

endchoice

config DEVICETREE
	default "devicetree_all_pcie.cb" if AMD_ONYX_BACKPLANES_ALL_PCIE
	default "devicetree_sata_p_link.cb" if AMD_ONYX_BACKPLANES_PLINK_SATA
	default "devicetree_sata_g_link.cb" if AMD_ONYX_BACKPLANES_GLINK_SATA
	default "devicetree_all_sata.cb" if AMD_ONYX_BACKPLANES_ALL_SATA

endif # BOARD_AMD_ONYX
```

## src/mainboard/intel/minnowmax/Kconfig
```kconfig
## SPDX-License-Identifier: GPL-2.0-only

if BOARD_INTEL_MINNOWMAX

config BOARD_SPECIFIC_OPTIONS
	def_bool y
	select BOARD_ROMSIZE_KB_8192
	select ENABLE_BUILTIN_COM1 if CONSOLE_SERIAL
	select HAVE_ACPI_RESUME
	select HAVE_ACPI_TABLES
	select HAVE_MRC
	select HAVE_OPTION_TABLE
	select INTEL_GMA_HAVE_VBT
	select SOC_INTEL_BAYTRAIL

config CBFS_SIZE
	hex
	default 0x00400000

config MAINBOARD_DIR
	string
	default "intel/minnowmax"

config MAINBOARD_PART_NUMBER
	string
	default "Minnow Max"

endif # BOARD_INTEL_MINNOWMAX
```

## src/soc/amd/genoa/Kconfig
```kconfig
# SPDX-License-Identifier: GPL-2.0-only

config SOC_AMD_GENOA
	bool
	help
	  AMD Genoa support

if SOC_AMD_GENOA

config SOC_SPECIFIC_OPTIONS
	def_bool y
	select ARCH_X86
	select ARCH_BOOTBLOCK_X86_32
	select ARCH_VERSTAGE_X86_32
	select ARCH_ROMSTAGE_X86_32
	select ARCH_RAMSTAGE_X86_32
	select GENERIC_GPIO_LIB
	select RESET_VECTOR_IN_RAM
	select SOC_AMD_COMMON
	select SOC_AMD_COMMON_BLOCK_ACPI
	select SOC_AMD_COMMON_BLOCK_ACPI_CPU_POWER_STATE
	select SOC_AMD_COMMON_BLOCK_ACPIMMIO
	select SOC_AMD_COMMON_BLOCK_ACPI_GPIO
	select SOC_AMD_COMMON_BLOCK_AOAC
	select SOC_AMD_COMMON_BLOCK_BANKED_GPIOS
	select SOC_AMD_COMMON_BLOCK_CPUFREQ_FAM17H_19H
	# TODO select SOC_AMD_COMMON_BLOCK_I2C
	select SOC_AMD_COMMON_BLOCK_LPC
	select SOC_AMD_COMMON_BLOCK_MCAX
	select SOC_AMD_COMMON_BLOCK_NONCAR
	select SOC_AMD_COMMON_BLOCK_PCI
	select SOC_AMD_COMMON_BLOCK_PCI_MMCONF
	select SOC_AMD_COMMON_BLOCK_SMI
	select SOC_AMD_COMMON_BLOCK_SMM
	select SOC_AMD_COMMON_BLOCK_SMU
	select SOC_AMD_COMMON_BLOCK_TSC
	select SOC_AMD_COMMON_BLOCK_TSC_FAM17H_19H
	select SOC_AMD_COMMON_BLOCK_UART
	select SOC_AMD_COMMON_BLOCK_UCODE
	select SOC_AMD_COMMON_BLOCK_SMU
	select SOC_AMD_COMMON_BLOCK_SMU_SX_ENTRY
	select SOC_AMD_COMMON_BLOCK_SVI3
	select SOC_AMD_COMMON_BLOCK_PSP
	select SOC_AMD_COMMON_BLOCK_PSP_GEN2
	select SOC_AMD_COMMON_BLOCK_IOMMU
	select FIXED_UART_FOR_CONSOLE
	select SOC_AMD_OPENSIL
	select X86_CUSTOM_BOOTMEDIA
	select DEFAULT_X2APIC
	select HAVE_SMI_HANDLER
	select SOC_ACPI_HEST
	select SOC_RAS_ELOG

config CHIPSET_DEVICETREE
	string
	default "soc/amd/genoa/chipset.cb"

config EARLY_RESERVED_DRAM_BASE
	hex
	default 0x7000000
	help
	  This variable defines the base address of the DRAM which is reserved
	  for usage by coreboot in early stages (i.e. before ramstage is up).
	  This memory gets reserved in BIOS tables to ensure that the OS does
	  not use it, thus preventing corruption of OS memory in case of S3
	  resume.

config EARLYRAM_BSP_STACK_SIZE
	hex
	default 0x1000

config PSP_APOB_DRAM_ADDRESS
	hex
	default 0x7001000
	help
	  Location in DRAM where the PSP will copy the AGESA PSP Output
	  Block.

config PSP_APOB_DRAM_SIZE
	hex
	default 0x20000

config PRERAM_CBMEM_CONSOLE_SIZE
	hex
	default 0x1600
	help
	  Increase this value if preram cbmem console is getting truncated

config C_ENV_BOOTBLOCK_SIZE
	hex
	default 0x10000
	help
	  Sets the size of the bootblock stage that should be loaded in DRAM.
	  This variable controls the DRAM allocation size in linker script
	  for bootblock stage.

config ROMSTAGE_ADDR
	hex
	default 0x7040000
	help
	  Sets the address in DRAM where romstage should be loaded.

config ROMSTAGE_SIZE
	hex
	default 0x80000
	help
	  Sets the size of DRAM allocation for romstage in linker script.

config ECAM_MMCONF_BASE_ADDRESS
	hex
	default 0xE0000000

config ECAM_MMCONF_BUS_NUMBER
	int
	default 256

config CONSOLE_UART_BASE_ADDRESS
	depends on CONSOLE_SERIAL && AMD_SOC_CONSOLE_UART
	hex
	default 0xfedc9000 if UART_FOR_CONSOLE = 0
	default 0xfedca000 if UART_FOR_CONSOLE = 1

menu "PSP Configuration Options"

config AMDFW_CONFIG_FILE
	string
	default "src/soc/amd/genoa/fw.cfg"

config PSP_DISABLE_POSTCODES
	bool "Disable PSP post codes"
	help
	  Disables the output of port80 post codes from PSP.

config PSP_INIT_ESPI
	bool "Initialize eSPI in PSP Stage 2 Boot Loader"
	help
	  Select to initialize the eSPI controller in the PSP Stage 2 Boot
	  Loader.

config PSP_LOAD_MP2_FW
	bool
	default n
	help
	  Include the MP2 firmwares and configuration into the PSP build.
	  If unsure, answer 'n'

config	PSP_UNLOCK_SECURE_DEBUG
	bool
	default y

config HAVE_PSP_WHITELIST_FILE
	bool "Include a debug whitelist file in PSP build"
	default n
	help
	  Support secured unlock prior to reset using a whitelisted
	  serial number. This feature requires a signed whitelist image
	  and bootloader from AMD.

	  If unsure, answer 'n'

config PSP_WHITELIST_FILE
	string "Debug whitelist file path"
	depends on HAVE_PSP_WHITELIST_FILE
	default "3rdparty/amd_blobs_internal/genoa/PSP/wtl-gno.bin"

config	HAVE_SPL_FILE
	bool

config SPL_TABLE_FILE
	string "SPL table file"
	depends on HAVE_SPL_FILE
	default "3rdparty/amd_blobs_internal/genoa/PSP/PspDirL10_Typex55_BLAntiRB.bin"

config PSP_SOFTFUSE_BITS
	string "PSP Soft Fuse bits to enable"
	default ""
	help
	  Space separated list of Soft Fuse bits to enable.
	  Bit 0:  Enable secure debug (Set by PSP_UNLOCK_SECURE_DEBUG)
	  Bit 7:  Disable PSP postcodes on Renoir and newer chips only
	          (Set by PSP_DISABLE_PORT80)
	  Bit 15: PSP post code destination: 0=LPC 1=eSPI
	          (Set by PSP_INITIALIZE_ESPI)
	  Bit 29: Disable MP2 firmware loading (Set by PSP_LOAD_MP2_FW)

	  See #55758 (NDA) for additional bit definitions.

config PSP_VERSTAGE_FILE
	string "Specify the PSP_verstage file path"
	depends on VBOOT_STARTS_BEFORE_BOOTBLOCK
	default "\$(obj)/psp_verstage.bin"
	help
	  Add psp_verstage file to the build & PSP Directory Table

config PSP_VERSTAGE_SIGNING_TOKEN
	string "Specify the PSP_verstage Signature Token file path"
	depends on VBOOT_STARTS_BEFORE_BOOTBLOCK
	default ""
	help
	  Add psp_verstage signature token to the build & PSP Directory Table
endmenu

config SMM_TSEG_SIZE
	hex
	default 0x800000 if HAVE_SMI_HANDLER
	default 0x0

config HEAP_SIZE
	hex
	default 0x200000

config MAX_CPUS
	int
	default 384

config DRIVERS_I2C_DESIGNWARE_CLOCK_MHZ
	int
	default 150

config ACPI_SSDT_PSD_INDEPENDENT
	bool "Allow core p-state independent transitions"
	default y
	help
	  AMD recommends the ACPI _PSD object to be configured to cause
	  cores to transition between p-states independently. A vendor may
	  choose to generate _PSD object to allow cores to transition together.

config ACPI_BERT
	bool "Build ACPI BERT Table"
	default y
	depends on HAVE_ACPI_TABLES
	help
	  Report Machine Check errors identified in POST to the OS in an
	  ACPI Boot Error Record Table.

config ACPI_BERT_SIZE
	hex
	default 0x4000 if ACPI_BERT
	default 0x0
	help
	  Specify the amount of DRAM reserved for gathering the data used to
	  generate the ACPI table.

endif # SOC_AMD_GENOA
```

## src/vendorcode/amd/opensil/Kconfig
```kconfig
menu "AMD OpenSIL configuration"

config AMD_OPENSIL_USE_EXTERNAL_ARCHIVE
	bool "Use external archive"

config AMD_OPENSIL_BIN_PATH
	string "Path to the opensil binary" if AMD_OPENSIL_USE_EXTERNAL_ARCHIVE
	default "$(obj)/opensil/libopensil_zen4.a" if !AMD_OPENSIL_USE_EXTERNAL_ARCHIVE

config AMD_OPENSIL_HEADER_PATH
	string "Path to the opensil base dir" if AMD_OPENSIL_USE_EXTERNAL_ARCHIVE
	default "$(top)/3rdparty/opensil" if !AMD_OPENSIL_USE_EXTERNAL_ARCHIVE

source "$(OPENSIL_DIR)/Kconfig"

endmenu
```

## src/vendorcode/amd/opensil/Kconfig.debug
```kconfig
config OPENSIL_DEBUG_OUTPUT
	bool "OpenSIL console output"
	default y
	help
	  Select this if you want OpenSIL debug messages compiled
	  in the image.

if OPENSIL_DEBUG_OUTPUT

config OPENSIL_DEBUG_PREFIX
	bool "Print the opensil prefix"
	default n
	help
	  This prints the function name and line level in front of the
	  actual message.

endif
```

## vilboz_defconfig
```kconfig
CONFIG_USE_AMD_BLOBS=y
CONFIG_VENDOR_GOOGLE=y
# CONFIG_ONBOARD_VGA_IS_PRIMARY is not set
CONFIG_BOARD_GOOGLE_VILBOZ=y
CONFIG_DRIVERS_AMD_ATOMBIOS=y
CONFIG_MAINBOARD_DO_NATIVE_VGA_INIT=y
CONFIG_PAYLOAD_NONE=y
```
